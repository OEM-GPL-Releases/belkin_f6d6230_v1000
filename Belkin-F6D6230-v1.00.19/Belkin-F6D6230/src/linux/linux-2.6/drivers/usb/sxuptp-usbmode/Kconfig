## Belkin-F6D6230-v1.00.19/Belkin-F6D6230/src/linux/linux-2.6/drivers/usb/sxuptp-usbmode/Kconfig
```kconfig
menu "Silex USB Deviceserver Support"

config USB_DEVICESERVER_USBMODE
	tristate "USB port mode selector"
	depends on USB_DEVICESERVER

endmenu
```

## Belkin-F6D6230-v1.00.19/Belkin-F6D6230/src/linux/linux-2.6/drivers/usb/sxuptp/Kconfig
```kconfig
menu "Silex USB Deviceserver"

config USB_DEVICESERVER
	tristate "USB Deviceserver"

config USB_DEVICESERVER_DEVFILTER
	tristate "Device filter"

endmenu
```
